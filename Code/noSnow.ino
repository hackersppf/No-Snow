/*
  Το προγραμμα για το αποχιονιστικό μηχάνημα που έχει συνδεδμένους του κινητήρες σε δυο θέσεις του οδηγού
*/

//Εισάγουμε όλες τις βιβλιοθήκες που θα χρειαστούμε. Μπορούμε να πάμε στα προγράμματα δοκιμών και να 
//αντιγράψουμε τις εντολές #include από εκεί
#include <dht.h>            //Αισθητήρας θερμοκρασίας DHT11
#include <NewPing.h>        //Αισθητήρας απόστασης υπέρηχων
#include <MPU6050_tockn.h>  //Μονάδα IMU (γυροσκόπιο)
#include <Wire.h>           //Βοηθητική για την μονάδα IMU
#include <AFMotor.h>        //Οδηγός των κινητήρων για τις ρόδες
#include <Servo.h>          //Servo κινητήρες για μαχαίρι και διασκορπιστή αλατιού
#include <Stepper.h>        //Βηματικός κινητήρας για μεταφορά αλατιού

//Ορίζουμε τα pin στα οποία έχουμε συνδέσει τις μονάδες σαν σταθερές με την εντολή define
//Έτσι αντί να χρησιμοποιούμε πλέον τους αριθμούς των pin στο πρόγραμμα μας θα χρησιμοποιούμε
//τα ονόματα που δίνουμε παρακάτω. Μπορούμε να πάμε στα προγράμματα δοκιμών και να 
//αντιγράψουμε τις εντολές #define από εκεί
#define pinT A14      //Αισθητήρας θερμοκρασίας DHT11 είναι στο pin Α14
#define pinR A15      //Αισθητήρας βροχής είναι στο pin Α15
#define pinD 23       //Αισθητήρας απόστασης είναι στο pin 23
#define pinP 25       //Αισθητήρας PIR είναι στο pin 25
#define pinS 27       //To ηχείο είναι στο pin 27
#define pinL 29       //To φως είναι στο pin 29
#define pinServoM 10  //To Servo του μαχαιριού είναι τοποθετημένο στην θέση SERVO2 του οδηγού που αντιστοιχεί στο digital pin 10
#define pinServoA 9   //To Servo της αλατιέρας είναι τοποθετημένο στην θέση SERVO1 του οδηγού που αντιστοιχεί στο digital pin 9

//Δημιουργούμε αντικείμενα - μεταβλητές, τα οποία έχουν τις δικές τους συναρτήσεις. 
//Μπορούμε να πάμε στα προγράμματα δοκιμών και να αντιγράψουμε τις δηλώσεις αντικειμένων από εκεί
Servo front;                            //Κινητήρας servo που ελέγχει το μαχαίρι
Servo back;                             //Κινητήρας servo που ελέγχει τον διασκορπιστή αλατιού
Stepper salt(1019, 35, 37, 39, 41);     //Κινητήρας βηματικός που ελέγχει τον κοχλία μεταφοράς αλατιού. Δηλώνουμε τα βήματα (1019) και σε ποια pin είναι συνδεδεμένος
dht DHT;                                //Μονάδα αισθητήρα θερμοκρασίας
MPU6050 imu(Wire);                      //Μονάδα IMU
NewPing sonar(pinD, pinD, 400);         //Μονάδα αισθητήρα απόστασης υπέρηχων. Δηλώνουμε σε ποιο pin είναι τα TRIG και ECHO (στο ίδιο pin) καθώς και το μέγιστο όριο απόστασης 

//Δηλώνουμε τους 4 κινητήρες του οχήματος σε ποιες θέσεις είναι τοποθετημένα
//Μπορούμε να πάμε στα προγράμματα δοκιμών και να αντιγράψουμε τις εντολές από εκεί
AF_DCMotor motorL(3); //Οι δυο αριστερά στην θέση 3
AF_DCMotor motorR(4); //Οι δυο δεξιά στην θέση 4

//Μεταβλητές που θα χρειαστούμε. Μπορούμε να πάμε στα προγράμματα δοκιμών και να 
//αντιγράψουμε τις μεταβλητές από εκεί
int pir;                //Εδώ θα διαβάζουμε την τωρινή τιμή από τον αισθητήρα PIR
float cm;               //Εδώ θα διαβάζουμε την τιμή από τον αισθητήρα απόστασης σε εκατοστά
float rain;             //Εδώ θα διαβάζουμε την τιμή του αισθητήρα βροχής/χιονιού
float temp;             //Εδώ θα διαβάζουμε την τιμή του αισθητήρα θερμοκρασίας
float mZ;               //Εδώ θα κρατάμε τις μοίρες περιστροφής γύρω από τον άξονα Ζ από την μονάδα IMU
boolean ice = false;    //Μεταβλητή θα παίρνει 2 τιμές, False αν δεν έχει πάγο και true αν έχει πάγο


//Η συνάρτηση start κάνει την αρχικοποίηση του οχήματος μας
//Θα πρέπει να ενεργοποιήσουμε το γυροσκόπιο και να σηκώσουμε το μαχαίρι
void start() {
  delay(5000);                  //Περιμένουμε 5 δευτερόλεπτα για να τοποθετήσουμε το όχημα
  digitalWrite(pinL,HIGH);      //Ανάβουμε το φως
  Wire.begin();                 //Ξεκινάμε τις βιβλιοθήκες της μονάδα imu
  imu.begin();                  //Ξεκινάμε τις βιβλιοθήκες της μονάδα imu 
  imu.calcGyroOffsets(true);    //Ζητάμε από την μονάδα να κάνει την αρχική ρύθμιση (θέλει 3 δευτερόλεπτα)
  digitalWrite(pinL,LOW);       //Μόλις η ρύθμιση τελειώσει σβήνουμε το φως.
  front.attach(pinServoM);      //Ενεργοποιώ τον κινητήρα servo του μαχαιριού
  front.write(90);              //Ανεβάζω το μαχαίρι ;
}

//Η συνάρτηση checkIce θα ελέγχει τις συνθήκες θερμοκρασίας και βροόπτωσης/χιονόπτωσης και
//αν αυτές είναι τέτοιες ώστε να υπάρχει πάγος θα κάνει την μεταβλητή ice true αλλιώς θα την κάνει false
void checkIce() {
  DHT.read11(pinT);                           //Διαβάζουμε τις τιμές από τον αισθητήρα θερμοκρασίας
  temp = DHT.temperature;                     //Παίρνουμε την θερμοκρασία στην μεταβλητή temp
  rain = map(analogRead(pinR),0,1023,100,0);  //Παίρνουμε την τιμή της βροχόπτωσης/χιονόπτωσης
  if (temp < 0 && rain > 50) {                //Αν η θερμοκρασίας είναι κάτω από 0 και υπάρχει βροόπτωση/χιονόπτωση πάνω από 50% τότε
    ice = true;                               //Κάνω την μεταβλητή του πάγου σε true  
  } else {                                    //Αλλιώς
    ice = false;                              //Κάνω την μεταβλητή του πάγου σε false  
  }
}

//Η συνάρτηση checkPir ελέγχει αν υπάρχει κίνηση ανθρώπων μπροστά από το όχημα και το σταματάει εκπέμποντας προειδοποιητικό ήχο και φως
void checkPir() {
  pir = digitalRead(pinP);      //Διαβάζω την τιμή του αισθητήρα PIR
  if (pir == HIGH) {            //Αν υπάρχει κίνηση
    motorR.run(RELEASE);        //Απενεργοποιώ τους κινητήρες
    motorL.run(RELEASE);        //Απενεργοποιώ τους κινητήρες 
    digitalWrite(pinL,HIGH);    //Ανάβω το φως 
    digitalWrite(pinS,HIGH);    //Ανοίγω το ηχείο 
  } else {                      //Αλλιώς αν δεν υπάρχει κίνηση 
    digitalWrite(pinL,LOW);     //Κλείνω το φως 
    digitalWrite(pinS,LOW);     //Κλείνω το ηχείο 
    motorR.run(FORWARD);        //Ενεργοποιώ τους κινητήρες
    motorL.run(FORWARD);        //Ενεργοποιώ τους κινητήρες
  }
}

//Η συνάρτηση drive οδηγεί το όχημα σε ευθεία στις μοίρες m που θέλουμε 
//Έτσι αν το όχημα μας κινείται μπροστά θα την γράψουμε ως drive(0), ενώ αν επιστρέφει 
//θα την γράψουμε ως drive(180).
void drive(float m) {       
  front.write(55);              //Κατεβάζω το μαχαίρι 
  motorR.run(FORWARD);          //Ενεργοποιούμε τους 4 κινητήρες 
  motorL.run(FORWARD);          //Ενεργοποιούμε τους 4 κινητήρες 
  cm = sonar.ping_cm();         //Παίρνουμε την απόσταση του τοίχου από τον αισθητήρα υπερήχων
  while (cm > 20 || cm == 0) {  //Όσο η απόσταση από τον τοίχο είναι μεγαλύτερη από 20 εκατοστά ή είναι μηδενική (μπορεί να μας δίνει τέτοια τιμή ο αισθητήρας αν δεν υπάρχει εμπόδιο κοντά
    checkPir();                 //Καλούμε τη συνάρτηση που ελέγχει για ανθρώπους
    if (ice == true) {          //Αν υπάρχει πάγος τότε
      salt.setSpeed(6);         //Ορίζω την ταχύτητα του κοχλία αλατιού σε 6 rpm
      salt.step(1);             //Περιστρέφω τον κοχλία της αλατιέρας για 1 βήμα
    }
    imu.update();               //Ανανεώνουμε τις τιμές του γυροσκόπιου
    mZ = imu.getAngleZ();       //Παίρνουμε τις μοίρες περιστροφής γύρω από τον άξονα Ζ
    if (mZ < m-1) {             //Αν η γωνία περιστροφής είναι μικρότερη από -1 μοίρα το όχημα έχει φύγει λίγο δεξιά οπότε
      motorR.setSpeed(150);     //Δίνουμε ταχύτητα 150 στους 2 κινητήρες δεξιά  
      motorL.setSpeed(0);       //Σταματάμε τους δυο κινητήρες αριστερά
    } else if (mZ > m+1) {      //Αν η γωνία περιστροφής είναι μεγαλύτερη από 1 μοίρα το όχημα έχει φύγει λίγο αριστερά οπότε
      motorL.setSpeed(150);     //Δίνουμε ταχύτητα 150 στους 2 κινητήρες αριστερά  
      motorR.setSpeed(0);       //Σταματάμε τους δυο κινητήρες δεξιά
    } else {                    //Αλλιώς αν δεν έχουμε ξεφύγει από την ευθεία
      motorL.setSpeed(150);     //Ορίζουμε την ταχύτητα και δεξιά και αριστερά στο 150
      motorR.setSpeed(150);     //Ορίζουμε την ταχύτητα και δεξιά και αριστερά στο 150
    }
    cm = sonar.ping_cm();       //Παίρνουμε ξανά την απόσταση του τοίχου από τον αισθητήρα υπερήχων   
  }                             
  motorR.run(RELEASE);          //Όταν πλέον φτάσουμε στον τοίχο απενεργοποιούμε τους 4 κινητήρες
  motorL.run(RELEASE);          //Απενεργοποιούμε τους 4 κινητήρες
  front.write(90);              //Ανεβάζω το μαχαίρι 
}

//Η συνάρητση turnLeft στρίβει το όχημα μας αριστερά μέχρι να φτάσει τις m μοίρες
void turnLeft(float m) {    
  while (mZ < m) {          //Όσο ακόμα δεν έχει φτάσει το όχημα τις επιθυμητές μοίρες
    motorL.run(BACKWARD);   //Βάζω τους αριστερά κινητήρες να κινηθούν ανάποδα
    motorR.run(FORWARD);    //Τους δεξιά κινητήρες να κινηθούν μπροστά
    motorL.setSpeed(200);   //Ορίζω την ταχύτητα των κινητήρων
    motorR.setSpeed(200);   //Ορίζω την ταχύτητα των κινητήρων
    imu.update();           //Ενημερώνω τις τιμές του γυροσκόπιου
    mZ = imu.getAngleZ();   //Παίρνω τη νέα τιμής της γωνίας Z
  }
  motorR.run(RELEASE);      //Όταν πλέον φτάσω τις επιθυμητές μοίρες απενεργοποιώ τους κινητήρες
  motorL.run(RELEASE);      //Απενεργοποιώ τους κινητήρες
}

//Η συνάρητση turnRight στρίβει το όχημα μας αριστερά μέχρι να φτάσει τις m μοίρες
void turnRight(float m) {    
  while (mZ > m) {          //Όσο ακόμα δεν έχει φτάσει το όχημα τις επιθυμητές μοίρες
    motorR.run(BACKWARD);   //Βάζω τους δεξιά κινητήρες να κινηθούν ανάποδα
    motorL.run(FORWARD);    //Τους αριστερά κινητήρες να κινηθούν μπροστά
    motorL.setSpeed(200);   //Ορίζω την ταχύτητα των κινητήρων
    motorR.setSpeed(200);   //Ορίζω την ταχύτητα των κινητήρων
    imu.update();           //Ενημερώνω τις τιμές του γυροσκόπιου
    mZ = imu.getAngleZ();   //Παίρνω τη νέα τιμής της γωνίας Z
  }
  motorR.run(RELEASE);      //Όταν πλέον φτάσω τις επιθυμητές μοίρες απενεργοποιώ τους κινητήρες
  motorL.run(RELEASE);      //Απενεργοποιώ τους κινητήρες
}

void setup() {
  //Ορίζω τα pin που χρειάζονται να δηλωθούν ως input και output
  pinMode(pinS,OUTPUT);   //Ορίζουμε το pin του ηχείου ως έξοδο
  pinMode(pinL,OUTPUT);   //Ορίζουμε το pin του φωτός ως έξοδο
  pinMode(pinP, INPUT);   //Ορίζουμε το pin του αισθητήρα PIR ως είσοδο
  
  //Τώρα ξεκινάν οι οδηγίες μας
  start();        //Βήμα 1ο Αρχικοποιώ το όχημα
  checkIce();     //Βήμα 2ο Ελέγχω τις συνθήκες θερμοκρασίας - υγρασίας για το αν υπάρχει πάγος
  
  //Οι οδηγίες που ακολουθούν καθαρίζουν έναν διάδρομο στην αυλή του σχολείου 
  //Μπορούμε να τις βάλουμε σε επανάληψη για να καθαρίσουμε περισσότερη επιφάνεια
  //Στα άμεσα σχέδια μας είναι να βελτιώσουμε τις οδηγίες ώστε να καθαρίζουν όλη την αυλή 
  drive(0);       //Βήμα 3ο Στέλνω το όχημα σε ευθεία μέχρι να βρει τον τοίχο
  delay(1000);    //Περιμένω 1 δευτερόλεπτο
  turnLeft(90);   //Βήμα 4ο Στρίβω αριστερά 90 μοίρες
  delay(1000);
  drive(90);      //Βήμα 5ο Οδηγώ σε ευθεία μέχρι να βρω τον τοίχο
  delay(1000);
  turnLeft(180);  //Βήμα 6ο Στρίβω αριστερά 180 μοίρες
  delay(1000);
  drive(180);     //Βήμα 7ο Οδηγώ σε ευθεία μέχρι να βρω τον τοίχο
}

void loop() {
}
